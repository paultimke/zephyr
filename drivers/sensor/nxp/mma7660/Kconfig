## drivers/sensor/nxp/mma7660/Kconfig
```kconfig
# MMA7660 3-axis accelerometer

# Copyright (c) Paul Timke <ptimkec@live.com>
# SPDX-License-Identifier: Apache-2.0

menuconfig MMA7660
    bool "MMA7660 accelerometer driver"
    default y
    depends on DT_HAS_NXP_MMA7660_ENABLED
    select I2C if $(dt_compat_on_bus,$(DT_COMPAT_NXP_MMA7660),i2c)
    help
      Enable driver for the MMA7660 accelerometer

if MMA7660

choice
    prompt "Trigger mode"
    default MMA7660_TRIGGER_NONE

config MMA7660_TRIGGER_NONE
    bool "No trigger"

config MMA7660_TRIGGER_GLOBAL_THREAD
    bool "Use global thread"
    depends on GPIO
    depends on $(dt_compat_any_has_prop,$(DT_COMPAT_NXP_MMA7660), int-gpio)
    select MMA7660_TRIGGER

config MMA7660_TRIGGER_OWN_THREAD
    bool "Use own thread"
    select MMA7660_TRIGGER

endchoice

config MMA7660_TRIGGER
    bool

if MMA7660_TRIGGER

config MMA7660_DRDY
    bool "Data ready interrupt"
    help
      Enable data ready interrupt

config MMA7660_TAP
    bool "Tap (Pulse) detection interrupt"
    help
      Enable tap detection interrupt

menuconfig MMA7660_SHAKE
    bool "Shake detection interrupt"
    help
      Enable shake detection interrupt

if MMA7660_SHAKE

config MMA7660_SHAKE_X
    bool "Shake detection on the X axis"
    help
      Enable shake detection on the X axis

config MMA7660_SHAKE_Y
    bool "Shake detection on the Y axis"
    help
      Enable shake detection on the Y axis

config MMA7660_SHAKE_Z
    bool "Shake detection on the Z axis"
    help
      Enable shake detection on the Z axis

endif # MMA7660_SHAKE

endif # MMA7660_TRIGGER

endif # MMA7660
```

## drivers/sensor/pixart/paj7620/Kconfig
```kconfig
# PAJ7620 gesture sensor configuration options

# Copyright (c) Paul Timke <ptimkec@live.com>
# SPDX-License-Identifier: Apache-2.0

menuconfig PAJ7620
	bool "PAJ7620 gesture sensor driver"
	default y
	depends on DT_HAS_PIXART_PAJ7620_ENABLED
	select I2C if $(dt_compat_on_bus, $(DT_COMPAT_PIXART_PAJ7620), i2c)
	help
	  Enable driver for the PAJ7620 gesture sensor


if PAJ7620

choice PAJ7620_TRIGGER_MODE
	prompt "Trigger mode"
	default PAJ7620_TRIGGER_NONE
	help
	  Specify the type of triggering to be used by the driver

config PAJ7620_TRIGGER_NONE
	bool "No trigger"

config PAJ7620_TRIGGER_GLOBAL_THREAD
	bool "Use global thread"
	depends on GPIO
	depends on $(dt_compat_any_has_prop,$(DT_COMPAT_PIXART_PAJ7620),int-gpios)
	select PAJ7620_TRIGGER

config PAJ7620_TRIGGER_OWN_THREAD
	bool "Use own thread"
	depends on GPIO
	depends on $(dt_compat_any_has_prop,$(DT_COMPAT_PIXART_PAJ7620),int-gpios)
	select PAJ7620_TRIGGER

endchoice

config PAJ7620_TRIGGER
	bool

if PAJ7620_TRIGGER

config PAJ7620_THREAD_PRIORITY
	int "Thread priority"
	depends on PAJ7620_TRIGGER_OWN_THREAD
	default 10
	help
	  Priority of the thread used by the driver to handle interrupts.

config PAJ7620_THREAD_STACK_SIZE
	int "Thread stack size"
	depends on PAJ7620_TRIGGER_OWN_THREAD
	default 1024
	help
	  Stack size of thread used by the driver to handle interrupts.

endif # PAJ7620_TRIGGER

endif # PAJ7620
```

## drivers/sensor/seeed/paj7620/Kconfig
```kconfig
# PAJ7620 gesture sensor

# Copyright (c) Paul Timke <ptimkec@live.com>
# SPDX-License-Identifier: Apache-2.0

menuconfig PAJ7620
    bool "PAJ7620 gesture sensor driver"
    default y
    depends on DT_HAS_SEEED_PAJ7620_ENABLED
    select I2C if $(dt_compat_on_bus, $(DT_COMPAT_SEEED_PAJ7620), i2c)
    help
      Enable driver for the PAJ7620 gesture sensor
```

## dts/bindings/sensor/nxp,mma7660.yaml
```yaml
# Copyright (c) Paul Timke <ptimkec@live.com>
# SPDX-License-Identifier: Apache-2.0

description: |
    NXP MMA7660 3-Axis Accelerometer. See datasheet at
    https://www.nxp.com/docs/en/data-sheet/MMA7660FC.pdf

compatible: "nxp,mma7660"

include: [sensor-device.yaml, i2c-device.yaml]

properties:
  int-gpio:
    type: phandle-array
    description: |
      INT pin
      TODO
```

## dts/bindings/sensor/seeed,paj7620.yaml
```yaml
# Copyright (c) Paul Timke <ptimkec@live.com>
# SPDX-License-Identifier: Apache-2.0
#
description: |
    Seeed PAJ7620 gesture sensor. See datasheet at
    https://datasheetspdf.com/pdf-file/1309990/PixArt/PAJ7620U2/1

compatible: "seeed,paj7620"

include: [sensor-device.yaml, i2c-device.yaml]

#properties:
#  int-gpio:
#    type: phandle-array
#    description: |
#      INT pin
#      TODO
```

## samples/sensor/gesture_polling/sample.yaml
```yaml
sample:
  name: Gesture polling sample
tests:
  sample.sensor.gesture_polling:
    build_only: true
    tags: sensors
    platform_allow: nucleo_f334r8
    depends_on:
      - i2c
      - paj7620
```
